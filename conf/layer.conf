## conf/layer.conf
```bitbake
# We have a conf and classes directory, add to BBPATH
BBPATH .= ":${LAYERDIR}"

# We have recipes-* directories, add to BBFILES
BBFILES += "${LAYERDIR}/recipes-*/*/*.bb \
            ${LAYERDIR}/recipes-*/*/*.bbappend"

BBFILE_COLLECTIONS += "meta-ew2026-workshop"
BBFILE_PATTERN_meta-ew2026-workshop = "^${LAYERDIR}/"
BBFILE_PRIORITY_meta-ew2026-workshop = "99"

LAYERDEPENDS_meta-ew2026-workshop = "core openembedded-layer meta-toradex-torizon sota meta-synaptics"
LAYERSERIES_COMPAT_meta-ew2026-workshop = "scarthgap"
```
